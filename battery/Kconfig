## battery/Kconfig
```kconfig
#
# For a description of the syntax of this configuration file,
# see the file kconfig-language.txt in the NuttX tools repository.
#

config ROCKETALT_BATMON
	bool "Altimeter battery monitor"
	default n
	depends on UORB
	depends on USENSOR
	---help---
		Monitors battery voltage and outputs it via uORB.

if ROCKETALT_BATMON

comment "Program options"

config ROCKETALT_BATMON_PRIORITY
	int "Priority"
	default 100
	---help---
		The task priority for the batmon uORB topics.

config ROCKETALT_BATMON_STACKSIZE
	int "Stack size"
	default 1024
	---help---
		The stack size for the batmon uORB topics. These are small programs
		which perform uORB operations.

comment "General"

config ROCKETALT_BATMON_VOLTAGE_QLEN
	int "Battery measurement queue length"
	default 5
	---help---
		The length of the queue to use for buffering battery measurements.

config ROCKETALT_BATMON_ADCPATH
	string "ADC device path"
	default "/dev/adc0"
	---help---
		The path to the ADC device where battery voltage can be read.

config ROCKETALT_BATMON_ADCRESOLUTION
	int "ADC resolution (bits)"
	---help---
		The ADC's resolution in bits.

config ROCKETALT_BATMON_BATMAX
	int "Battery max voltage (mV)"
	---help---
		The battery's maximum voltage in millivolts.

endif # ROCKETALT_BATMON
```

## btdaemon/Kconfig
```kconfig
#
# For a description of the syntax of this configuration file,
# see the file kconfig-language.txt in the NuttX tools repository.
#

menuconfig ROCKETALT_BTDAEMON
	tristate "Bluetooth daemon"
	default n
	depends on UORB
	depends on USENSOR
	depends on NIMBLE
	depends on WIRELESS_BLUETOOTH
	---help---
		Bluetooth daemon for publishing status over BLE and allowing device
		configuration over Bluetooth.

if ROCKETALT_BTDAEMON

comment "Program options"

config ROCKETALT_BTDAEMON_PRIORITY
	int "Priority"
	default 100
	---help---
		The task priority for the btdaemon program.

config ROCKETALT_BTDAEMON_STACKSIZE
	int "Stack size"
	default 2048
	---help---
		The stack size for the btdaemon program.

comment "Bluetooth GAP options"

config ROCKETALT_BTDAEMON_GAPNAME
	string "GAP name"
	default "Rocketalt"
	---help---
		The Bluetooth GAP name to use. This is what shows up as the name in
		discovery when advertising.

comment "Bluetooth device info options"

config ROCKETALT_BTDAEMON_DEVNAME
	string "Device name"
	default "Rocket Altimeter"
	---help---
		The Bluetooth device name to use. This is what shows up as the device
		model under the device information service.

config ROCKETALT_BTDAEMON_MANNAME
	string "Manufacturer name"
	default "Apache NuttX"
	---help---
		This is what shows up as the manufacturer model under the device
		information service.

config ROCKETALT_BTDAEMON_HWREV
	string "Hardware revision"
	default "0"
	---help---
		This is what shows up as the hardware revision under the device
		information service.

endif # ROCKETALT_BTDAEMON
```

## deployment/Kconfig
```kconfig
#
# For a description of the syntax of this configuration file,
# see the file kconfig-language.txt in the NuttX tools repository.
#

config ROCKETALT_DEPLOYMENT
	bool "Deployment logic"
	default n
	depends on UORB
	depends on USENSOR
	depends on !DISABLE_PTHREAD
	---help---
		Logic for triggering deployment of recovery systems based on flight
		events and rocket altitude.

if ROCKETALT_DEPLOYMENT

comment "Program options"

config ROCKETALT_DEPLOYMENT_PRIORITY
	int "Priority"
	default 100
	---help---
		The task priority for the deployment program.

config ROCKETALT_DEPLOYMENT_STACKSIZE
	int "Stack size"
	default 2048
	---help---
		The stack size for the deployment program.

config ROCKETALT_DEPLOYMENT_TMRTHREAD_STACKSIZE
	int "Timer thread stack size"
	default 2048
	---help---
		The stack size to use for the timer thread (handles timer-based
		deployment events).

comment "General options"

config ROCKETALT_DEPLOYMENT_NUMCHANS
	int "Number of deployment channels"
	default 1
	---help---
		Configures the number of deployment channels that exist on the device.

config ROCKETALT_DEPLOYMENT_QLEN
	int "Queue length"
	default 5
	---help---
		How many deployment events can be stored in the queue buffer at
		once while publishing data.

config ROCKETALT_DEPLOYMENT_MOCK
	bool "Mocking mode"
	default n
	---help---
		Enables mocking mode; hardware acuations that cause deployment are
		replaced with INFO syslogs.

endif # ROCKETALT_DEPLOYMENT
```

## fake_baro/Kconfig
```kconfig
#
# For a description of the syntax of this configuration file,
# see the file kconfig-language.txt in the NuttX tools repository.
#

menuconfig ROCKETALT_FAKE_BARO
	tristate "Fake barometer topic"
	default n
	depends on UORB
	depends on USENSOR
	---help---
		Contains the implementation of a fake barometer to perform testing
		without access to a real barometric pressure sensor.

if ROCKETALT_FAKE_BARO

comment "Program options"

config ROCKETALT_FAKE_BARO_PRIORITY
	int "Priority"
	default 100
	---help---
		The task priority for the fake_baro uORB topic.

config ROCKETALT_FAKE_BARO_STACKSIZE
	int "Stack size"
	default 2048
	---help---
		The stack size for the fake_baro uORB topic.

comment "Fake data options"

config ROCKETALT_FAKE_BARO_QLEN
	int "Queue length"
	default 5
	---help---
		How many barometer measurements can be stored in the queue buffer at
		once while publishing data.

choice
	prompt "Fake barometer implementation"
	default ROCKETALT_FAKE_BARO_USECSV

config ROCKETALT_FAKE_BARO_USECSV
	bool "Fake data from CSV file"
	depends on SENSORS_FAKESENSOR
	---help---
		Implementation of the fake barometer using a CSV file from which data
		can be read and published.

config ROCKETALT_FAKE_BARO_USEBLE
	bool "Fake data from Bluetooth"
	---help---
		Implementation of the fake barometer using a Bluetooth service to
		recieve and publish barometer data from some other device.

config ROCKETALT_FAKE_BARO_USECURVE
	bool "Fake data from a curve"
	---help---
		Implementation of the fake barometer using a pre-defined mathematical
		curve to generate fake barometer data.
	
endchoice

endif # ROCKETALT_FAKE_BARO
```

## processing/Kconfig
```kconfig
#
# For a description of the syntax of this configuration file,
# see the file kconfig-language.txt in the NuttX tools repository.
#

menuconfig ROCKETALT_PROCESSING
	tristate "Data processing logic"
	default n
	depends on UORB
	depends on USENSOR
	---help---
		Primary logic for performing altimeter calculations. Includes altitude
		estimation, filtering and event detection through the uORB framework.

if ROCKETALT_PROCESSING

comment "Program options"

config ROCKETALT_PROCESSING_PRIORITY
	int "Priority"
	default 100
	---help---
		The task priority for the processing uORB topics.

config ROCKETALT_PROCESSING_STACKSIZE
	int "Stack size"
	default 2048
	---help---
		The stack size for the processing uORB topics. These are small programs
		which perform uORB operations.

comment "Data processing programs"

source "$APPSDIR/rocket-altimeter/processing/altitude/Kconfig"
source "$APPSDIR/rocket-altimeter/processing/velocity/Kconfig"
source "$APPSDIR/rocket-altimeter/processing/events/Kconfig"
source "$APPSDIR/rocket-altimeter/processing/batmon/Kconfig"
source "$APPSDIR/rocket-altimeter/processing/continuity/Kconfig"

endif # ROCKETALT_PROCESSING
```

## processing/adc_uorb/Kconfig
```kconfig
menuconfig ROCKETALT_PROCESSING_ADCUORB
	bool "ADC to uORB"
	depends on ADC
	default n
	---help---
		Enables the program that converts ADC measurements into uORB voltage
		measurements. Each individual ADC channel is given its own uniquely
		numbered uORB topic.

if ROCKETALT_PROCESSING_ADCUORB

config ROCKETALT_PROCESSING_ADCUORB_QLEN
	int "Voltage measurement queue length"
	default 3
	---help---
		The length of the uORB queue to use (per topic) for buffering voltage
		measurements.

endif # ROCKETALT_PROCESSING_ADCUORB
```

## processing/altitude/Kconfig
```kconfig
menuconfig ROCKETALT_PROCESSING_ALTFUSION
	bool "Altitude fusion"
	default n
	---help---
		Enables the program that performs altitude fusion from barometric
		pressure data.

if ROCKETALT_PROCESSING_ALTFUSION

config ROCKETALT_PROCESSING_ALTFUSION_QLEN
	int "Altitude queue length"
	default 5
	---help---
		The length of the queue to use for buffering altitude measurements.

config ROCKETALT_PROCESSING_HEIGHTFUSION_QLEN
	int "Height queue length"
	default 5
	---help---
		The length of the queue to use for buffering height measurements.

endif # ROCKETALT_PROCESSING_ALTFUSION
```

## processing/batmon/Kconfig
```kconfig
menuconfig ROCKETALT_PROCESSING_BATMON
	bool "Battery monitor"
	default n
	---help---
		Enables the program that monitors a battery connected to a voltage
		topic.

if ROCKETALT_PROCESSING_BATMON

config ROCKETALT_BATMON_QLEN
	int "Battery measurement queue length"
	default 5
	---help---
		The length of the queue to use for buffering battery measurements.

comment "Battery options"

choice
	prompt "Battery chemistry"
	default ROCKETALT_BATMON_CHEM_UNK
	
config ROCKETALT_BATMON_CHEM_UNK
	bool "Unknown"
	---help---
		The battery chemistry is unknown (can also use this option if chemistry
		is not listed as a supported option).

config ROCKETALT_BATMON_CHEM_LIPO
	bool "LiPo"
	---help---
		Assume the connected battery is a lithium polymer battery.

config ROCKETALT_BATMON_CHEM_LIION
	bool "Li-Ion"
	---help---
		Assume the connected battery is a lithium ion battery.

endchoice # Battery chemistry

if ROCKETALT_BATMON_CHEM_UNK

config ROCKETALT_BATMON_BATMAX
	int "Battery max voltage (mV)"
	---help---
		The battery's maximum voltage in millivolts.

endif # ROCKETALT_BATMON_CHEM_UNK

endif # ROCKETALT_PROCESSING_BATMON
```

## processing/continuity/Kconfig
```kconfig
menuconfig ROCKETALT_PROCESSING_CONTMON
	bool "Continuity monitor"
	default n
	---help---
		Enable support for monitoring continuity of deployment channels using an
		ADC.

if ROCKETALT_PROCESSING_CONTMON

config ROCKETALT_CONTMON_QLEN
	int "Continuity measurement queue length"
	default 5
	---help---
		The length of the queue to use for buffering continuity measurements.

endif # ROCKETALT_PROCESSING_CONTMON
```

## processing/events/Kconfig
```kconfig
menuconfig ROCKETALT_PROCESSING_EVENTS
	bool "Flight event detection"
	default n
	---help---
		Enables the program that performs flight event detection from sensor
		data.

if ROCKETALT_PROCESSING_EVENTS

config ROCKETALT_EVENT_QLEN
	int "Queue length"
	default 3
	---help---
		The length of the queue to use for buffering flight events.

config ROCKETALT_EVENT_SYSLOG
	bool "Syslog event output"
	default n
	---help---
		If enabled, flight event changes are syslogged as INFO.

endif # ROCKETALT_PROCESSING_EVENTS
```

## processing/velocity/Kconfig
```kconfig
menuconfig ROCKETALT_PROCESSING_VELFUSION
	bool "Velocity fusion"
	default n
	---help---
		Enables the program that performs velocity fusion from altitude
		measurements.

if ROCKETALT_PROCESSING_VELFUSION

config ROCKETALT_VELFUSION_QLEN
	int "Queue length"
	default 5
	---help---
		The length of the queue to use for buffering velocity measurements.

endif # ROCKETALT_PROCESSING_VELFUSION
```

## sensor/Kconfig
```kconfig
config ROCKETALT_SENSORS
	tristate "Sensor definitions"
	depends on UORB
	default n
	---help---
		Definitions for sensor/uORB topics used by the rocket altimeter.
```
